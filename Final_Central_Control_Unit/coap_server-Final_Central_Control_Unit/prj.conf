## prj.conf
```kconfig
#
# Copyright (c) 2020 Nordic Semiconductor
#
# SPDX-License-Identifier: LicenseRef-Nordic-5-Clause
#

# nRF board library
CONFIG_DK_LIBRARY=y

# Enable OpenThread CoAP support API
CONFIG_OPENTHREAD_COAP=y

# Network shell
#CONFIG_SHELL=y
#CONFIG_OPENTHREAD_SHELL=y
#CONFIG_SHELL_ARGC_MAX=26
#CONFIG_SHELL_CMD_BUFF_SIZE=416

# Network sockets
CONFIG_NET_SOCKETS=y
CONFIG_NET_SOCKETS_POSIX_NAMES=y
CONFIG_NET_SOCKETS_POLL_MAX=4

# Same network Master Key for client and server
CONFIG_OPENTHREAD_NETWORKKEY="00:11:22:33:44:55:66:77:88:99:aa:bb:cc:dd:ee:ff"

# L2 OpenThread enabling
CONFIG_NET_L2_OPENTHREAD=y

# Generic networking options
CONFIG_NETWORKING=y

CONFIG_MBEDTLS_SHA1_C=n
CONFIG_FPU=y
#My extras
CONFIG_LOG=y
CONFIG_COAP_SERVER_LOG_LEVEL_DBG=y
CONFIG_OT_COAP_UTILS_LOG_LEVEL_DBG=y

CONFIG_HEAP_MEM_POOL_SIZE=2048

# For board-to-board communication
#CONFIG_I2C=y
#CONFIG_IMU_LOG_LEVEL_DBG=y
# Stuff for encoder
CONFIG_GPIO=y
CONFIG_NEWLIB_LIBC=y
CONFIG_NEWLIB_LIBC_FLOAT_PRINTF=y
CONFIG_ENCODER_LOG_LEVEL_INF=y

# Enable channel management
CONFIG_OPENTHREAD_CHANNEL_MONITOR=y
CONFIG_OPENTHREAD_CHANNEL_MANAGER=y
# Stuff for checking which channel we're in seperately.
CONFIG_NRF_802154_RADIO_CONFIG=y
CONFIG_NRF_802154_RADIO_DRIVER=y

# Client server stuff
CONFIG_LOG=y
CONFIG_COAP_CLIENT_UTILS_LOG_LEVEL_DBG=y

# Enable CoAP utils and CoAP protocol
CONFIG_COAP_UTILS=y

#Flash usage
#CONFIG_FLASH=y

#Uart
CONFIG_SERIAL=y
CONFIG_UART_ASYNC_API=y
```

## src/AEDB_9140.c
```c
#include "AEDB_9140.h"
#include "zephyr/kernel.h"
#include <math.h>
#include <zephyr/device.h>
#include <zephyr/drivers/gpio.h>


static const struct gpio_dt_spec ChannelA_Encoder =
    GPIO_DT_SPEC_GET(DT_NODELABEL(encodercha), gpios);
static const struct gpio_dt_spec ChannelB_Encoder =
    GPIO_DT_SPEC_GET(DT_NODELABEL(encoderchb), gpios);
static const struct gpio_dt_spec ChannelI_Encoder =
    GPIO_DT_SPEC_GET(DT_NODELABEL(encoderindex), gpios);

static struct gpio_callback encoderA_callback;
static struct gpio_callback encoderB_callback;
static struct gpio_callback encoderI_callback;

static const int QEM[4][4] = {{0, -1, 1, 2},
                              {1, 0, 2, -1},
                              {-1, 2, 0, 1},
                              {2, 1, -1, 0}}; // Quadrature Encoder Matrix
int state = 0;
int oldState = 0;
int32_t position = 0;
int32_t position_prevfullrev = 0;
int32_t FullResolutionPositionCount = 0;
int32_t intVel = 0;
float floatVel = 0.0f;
int32_t intAcc = 0;
float floatAcc = 0.0f;

int aState = 0;
int bState = 0;

int32_t getIntVel(void) { return intVel; }
float getFloatVel(void) { return floatVel; }
int32_t getIntAcc(void) { return intAcc; }
float getFloatAcc(void) { return floatAcc; }


void setPosition(struct k_work *work) {
  static int oldState = 0;
  state = (bState << 1) + aState;
  position += QEM[state][oldState];
  // return state, oldState, position;
  oldState = state;
}
K_WORK_DEFINE(setPosition_work, setPosition);
void aChange() {
  aState = gpio_pin_get_dt(&ChannelA_Encoder);
  k_work_submit(&setPosition_work);
}
void bChange() {
  bState = gpio_pin_get_dt(&ChannelB_Encoder);
  k_work_submit(&setPosition_work);
}

void FullRotationCounter() {
  FullResolutionPositionCount = position - position_prevfullrev;
  position_prevfullrev = position;
}

void measure(struct k_work *work) {
  static uint8_t count = 0;
  setVelocity();
  if (count % 2 == 0) {
    setAcceleration();
  }
}
K_WORK_DEFINE(measure_work, measure);

void measureInterrupt(struct k_timer *timer_id) {
  k_work_submit(&measure_work);
}
K_TIMER_DEFINE(measureTime, measureInterrupt, NULL);

void Setup_interrupt(void) {
  gpio_pin_interrupt_configure_dt(&ChannelA_Encoder, GPIO_INT_EDGE_BOTH);
  gpio_pin_interrupt_configure_dt(&ChannelB_Encoder, GPIO_INT_EDGE_BOTH);

  gpio_init_callback(&encoderA_callback, aChange, BIT(ChannelA_Encoder.pin));
  gpio_add_callback(ChannelA_Encoder.port, &encoderA_callback);
  gpio_init_callback(&encoderB_callback, bChange, BIT(ChannelB_Encoder.pin));
  gpio_add_callback(ChannelB_Encoder.port, &encoderB_callback);

  k_timer_start(&measureTime, K_SECONDS(0), K_MSEC(ENCODER_SAMPLE_PERIOD_MS));
}

void resetPosition(int32_t in) { position = in; return; }

int32_t getPosition(void) { return position; }

// Should be called every period.
void setVelocity(void) {
  static int32_t previousPosition = 0;
  intVel = position - previousPosition;
  floatVel =
      (float)intVel * (40.85E-6) / (float)ENCODER_SAMPLE_PERIOD_MS * 1000.0f;
  previousPosition = position;
}

// Should be called every 3rd period.
void setAcceleration(void) {
  static int32_t previousVelocity = 0;
  static float previousFloatVel = 0;
  intAcc = intVel - previousVelocity;
  floatAcc = (floatVel - previousFloatVel) / (float)ENCODER_SAMPLE_PERIOD_MS /
             3.0f * 1000.0f;
  previousVelocity = intVel;
  previousFloatVel = floatVel;
}

void encoderTestLoop(void) {
  for (int i = 1;; i++) {
    k_msleep((int32_t)(ENCODER_SAMPLE_PERIOD_MS * 1000.0f));
    LOG_DBG("Pos: %d, Vel: %.3f, Acc: %3f\n", getPosition(), getFloatVel(),
            getFloatAcc());
    k_msleep((int32_t)(ENCODER_SAMPLE_PERIOD_MS));
    setVelocity();
    if (i % 3 == 0) {
      setAcceleration();
      i = 0;
    }
  }
}
```

## src/AEDB_9140.h
```c
#ifndef AEDB_9140_H
#define AEDB_9140_H
/*
    AEDB-9140 Encoder Header File
    The University of Manchester
    Steps for use on Nordic NRF52833 Board
    1. Add Inputs for three pins in Device Trees in Overlay file
    2. Add this header file to target sources in "CMakeLists.txt" as
   "target_sources(app PRIVATE src/AEDB-9140.h)"
    3. Include this header file in main.c

*/
#include <zephyr/kernel.h>

#define ENCODER_SAMPLE_PERIOD_MS 100

int32_t getIntVel(void);
float getFloatVel(void);
int32_t getIntAcc(void);
float getFloatAcc(void);
int32_t getPosition(void);
void resetPosition(int32_t in);

void Setup_interrupt(void);
void encoderTestLoop(void);

// Should be called every period.
void setVelocity(void);
// Should be called every 3rd period.
void setAcceleration(void);

#endif
```

## src/coap_client_utils.c
```c
/*
 * Copyright (c) 2020 Nordic Semiconductor ASA
 *
 * SPDX-License-Identifier: LicenseRef-Nordic-5-Clause
 */

#include "coap_server_client_interface.h"
#include <net/coap_utils.h>
#include <openthread/thread.h>
#include <string.h>
#include <sys/_stdint.h>
#include <zephyr/logging/log.h>
#include <zephyr/net/openthread.h>
#include <zephyr/net/socket.h>

#include "coap_client_utils.h"
#include "node.h"
#include "zephyr/kernel.h"
#include "zephyr/net/coap.h"

LOG_MODULE_REGISTER(coap_client_utils, CONFIG_COAP_CLIENT_UTILS_LOG_LEVEL);

// How often client will poll for response.
#define RESPONSE_POLL_PERIOD 100

static int serverSelector = 0;
static int connectSelector = 0;
static int serverTarget = 0;

static uint32_t poll_period;

static bool is_connected[6];
CONNECTIONS();

static struct k_work unicast_light_work;
static struct k_work multicast_light_work;
static struct k_work toggle_MTD_SED_work;
static struct k_work provisioning_work;

static struct k_work genericSend_work;
static struct k_work floatSend_work;
static struct k_work percentageSend_work;
static struct k_work encoderSend_work;
static struct k_work commandSend_work;

// Must point to something of size GENERIC_PAYLOAD_SIZE
static char messagePointer[GENERIC_PAYLOAD_SIZE] = {};
static struct encoderMessage encoderPointer[1] = {};

static double floatPointer[1] = {};

static struct percentageStructHidden percentagePointer[1] = {};
static struct commandMsg cmdPointer[1] = {};
static int cmdDoMulti = 0;

mtd_mode_toggle_cb_t on_mtd_mode_toggle;

/* Options supported by the server */
static const char *const light_option[] = {LIGHT_URI_PATH, NULL};
static const char *const provisioning_option[] = {PROVISIONING_URI_PATH, NULL};
static const char *const generic_option[] = {GENERIC_URI_PATH, NULL};
static const char *const float_option[] = {FLOAT_URI_PATH, NULL};
static const char *const percentage_option[] = {PERCENTAGE_URI_PATH, NULL};
static const char *const encoder_option[] = {ENCODER_URI_PATH, NULL};
static const char *const cmd_option[] = {CMD_URI_PATH, NULL};

/* Thread multicast mesh local address */
static struct sockaddr_in6 multicast_local_addr = {
    .sin6_family = AF_INET6,
    .sin6_port = htons(COAP_PORT),
    .sin6_addr.s6_addr = {0xff, 0x03, 0x00, 0x00, 0x00, 0x00, 0x00, 0x00, 0x00,
                          0x00, 0x00, 0x00, 0x00, 0x00, 0x00, 0x01},
    .sin6_scope_id = 0U};

/* Variable for storing server address acquiring in provisioning handshake */
static char unique_local_addr_str[6][INET6_ADDRSTRLEN];
static struct sockaddr_in6 unique_local_addr[6] = {
    {.sin6_family = AF_INET6,
     .sin6_port = htons(COAP_PORT),
     .sin6_addr.s6_addr =
         {
             0,
         },
     .sin6_scope_id = 0U},
    {.sin6_family = AF_INET6,
     .sin6_port = htons(COAP_PORT),
     .sin6_addr.s6_addr =
         {
             0,
         },
     .sin6_scope_id = 0U},
    {.sin6_family = AF_INET6,
     .sin6_port = htons(COAP_PORT),
     .sin6_addr.s6_addr =
         {
             0,
         },
     .sin6_scope_id = 0U},
    {.sin6_family = AF_INET6,
     .sin6_port = htons(COAP_PORT),
     .sin6_addr.s6_addr =
         {
             0,
         },
     .sin6_scope_id = 0U},
    {.sin6_family = AF_INET6,
     .sin6_port = htons(COAP_PORT),
     .sin6_addr.s6_addr =
         {
             0,
         },
     .sin6_scope_id = 0U},
    {.sin6_family = AF_INET6,
     .sin6_port = htons(COAP_PORT),
     .sin6_addr.s6_addr =
         {
             0,
         },
     .sin6_scope_id = 0U}};

// Added
void serverScroll(void) {
  connectSelector++;
  connectSelector = connectSelector % SERVERS;
  serverSelector = connections[connectSelector];
  LOG_INF("Server %i | On? %i | Addr %s", serverSelector,
          is_connected[serverSelector], unique_local_addr_str[serverSelector]);
}
// Added/

static bool is_mtd_in_med_mode(otInstance *instance) {
  return otThreadGetLinkMode(instance).mRxOnWhenIdle;
}

static void poll_period_response_set(void) {
  otError error;

  otInstance *instance = openthread_get_default_instance();

  if (is_mtd_in_med_mode(instance)) {
    return;
  }

  if (!poll_period) {
    poll_period = otLinkGetPollPeriod(instance);

    error = otLinkSetPollPeriod(instance, RESPONSE_POLL_PERIOD);
    __ASSERT(error == OT_ERROR_NONE, "Failed to set pool period");

    LOG_INF("Poll Period: %dms set", RESPONSE_POLL_PERIOD);
  }
}

static void poll_period_restore(void) {
  otError error;
  otInstance *instance = openthread_get_default_instance();

  if (is_mtd_in_med_mode(instance)) {
    return;
  }

  if (poll_period) {
    error = otLinkSetPollPeriod(instance, poll_period);
    __ASSERT_NO_MSG(error == OT_ERROR_NONE);

    LOG_INF("Poll Period: %dms restored", poll_period);
    poll_period = 0;
  }
}

static int on_provisioning_reply(const struct coap_packet *response,
                                 struct coap_reply *reply,
                                 const struct sockaddr *from) {
  int ret = 0;
  const uint8_t *payload;
  uint16_t payload_size = 0u;

  ARG_UNUSED(reply);
  ARG_UNUSED(from);

  payload = coap_packet_get_payload(response, &payload_size);

  if (payload == NULL ||
      payload_size != sizeof(unique_local_addr[serverSelector].sin6_addr)) {
    LOG_ERR("Received data is invalid");
    ret = -EINVAL;
    goto exit;
  }

  memcpy(&unique_local_addr[serverSelector].sin6_addr, payload, payload_size);

  if (!inet_ntop(AF_INET6, payload, unique_local_addr_str[serverSelector],
                 INET6_ADDRSTRLEN)) {
    LOG_ERR("Received data is not IPv6 address: %d", errno);
    ret = -errno;
    goto exit;
  }

  LOG_INF("Received peer address: %s for %d",
          unique_local_addr_str[serverSelector], serverSelector);

exit:
  if (IS_ENABLED(CONFIG_OPENTHREAD_MTD_SED)) {
    poll_period_restore();
  }

  return ret;
}

static void toggle_one_light(struct k_work *item) {
  uint8_t payload = (uint8_t)THREAD_COAP_UTILS_LIGHT_CMD_TOGGLE;

  ARG_UNUSED(item);

  if (unique_local_addr[serverSelector].sin6_addr.s6_addr16[0] == 0) {
    LOG_WRN("Peer address not set. Activate 'provisioning' option "
            "on the server side");
    return;
  }

  LOG_INF("Send 'light' request to: %s", unique_local_addr_str[serverSelector]);
  coap_send_request(COAP_METHOD_PUT,
                    (const struct sockaddr *)&unique_local_addr[serverSelector],
                    light_option, &payload, sizeof(payload), NULL);
}

static void toggle_mesh_lights(struct k_work *item) {
  static uint8_t command = (uint8_t)THREAD_COAP_UTILS_LIGHT_CMD_OFF;

  ARG_UNUSED(item);

  command = ((command == THREAD_COAP_UTILS_LIGHT_CMD_OFF)
                 ? THREAD_COAP_UTILS_LIGHT_CMD_ON
                 : THREAD_COAP_UTILS_LIGHT_CMD_OFF);

  LOG_INF("Send multicast mesh 'light' request");
  coap_send_request(COAP_METHOD_PUT,
                    (const struct sockaddr *)&multicast_local_addr,
                    light_option, &command, sizeof(command), NULL);
}

static void send_provisioning_request(struct k_work *item) {
  ARG_UNUSED(item);

  if (IS_ENABLED(CONFIG_OPENTHREAD_MTD_SED)) {
    /* decrease the polling period for higher responsiveness */
    poll_period_response_set();
  }

  LOG_INF("Send 'provisioning' request");
  coap_send_request(COAP_METHOD_GET,
                    (const struct sockaddr *)&multicast_local_addr,
                    provisioning_option, NULL, 0u, on_provisioning_reply);
}
// Added
static void genericSend(struct k_work *item) {
  ARG_UNUSED(item);

  LOG_DBG("Generic send to %s", unique_local_addr_str[serverTarget]);

  if (coap_send_request(
          COAP_METHOD_PUT,
          (const struct sockaddr *)&unique_local_addr[serverTarget],
          generic_option, messagePointer, GENERIC_PAYLOAD_SIZE, NULL) >= 0) {

    LOG_DBG("Generic message send success!\n%s", messagePointer);
  } else {
    LOG_DBG("Generic message send fail.\n%s", messagePointer);
  }
}
static void floatSend(struct k_work *item) {
  ARG_UNUSED(item);
  LOG_DBG("Float send to %s", unique_local_addr_str[serverTarget]);
  if (coap_send_request(
          COAP_METHOD_PUT,
          (const struct sockaddr *)&unique_local_addr[serverTarget],
          float_option, (char *)floatPointer, sizeof(double), NULL) >= 0) {

    LOG_DBG("Float message send success!\n%.3f", *floatPointer);
  } else {
    LOG_DBG("Float message send fail.\n%.3f", *floatPointer);
  }
}
static void percentageSend(struct k_work *item) {
  ARG_UNUSED(item);
  if (coap_send_request(
          COAP_METHOD_PUT,
          (const struct sockaddr *)&unique_local_addr[serverTarget],
          percentage_option, (char *)percentagePointer, PERCENTAGE_PAYLOAD_SIZE,
          NULL) >= 0) {
    LOG_DBG("Percentage message send success!\n%s",
            percentagePointer->identifier);
  } else {
    LOG_DBG("Percentage message send fail.\n%s", percentagePointer->identifier);
  }
}
static void encoderSend(struct k_work *item) {
  ARG_UNUSED(item);
  if (coap_send_request(
          COAP_METHOD_PUT,
          (const struct sockaddr *)&unique_local_addr[serverTarget],
          encoder_option, (char *)encoderPointer, ENCODER_PAYLOAD_SIZE,
          NULL) >= 0) {
    LOG_DBG("Encoder message send success!\n");
  } else {
    LOG_DBG("Encoder message send fail!\n");
  }
}
static void cmdSend(struct k_work *item) {
  const struct sockaddr *address;
  if (cmdDoMulti) {
    address = (const struct sockaddr *)&multicast_local_addr;
  } else {
    address = (const struct sockaddr *)&unique_local_addr[serverTarget];
  }
  ARG_UNUSED(item);
  if (coap_send_request(COAP_METHOD_PUT, address, cmd_option,
                        (char *)cmdPointer, CMD_PAYLOAD_SIZE, NULL) >= 0) {
    LOG_DBG("Cmd message send success!\n");
  } else {
    LOG_DBG("Cmd message send fail!\n");
  }
}
// Added/

static void submit_work_if_connected(struct k_work *work) {
  if (serverTarget == -1) {
    LOG_DBG("Multicast Target!");
  } else {
    LOG_DBG("Target is %d AKA %s", serverTarget,
            unique_local_addr_str[serverTarget]);
  }
  if (true) {
    k_work_submit(work);
  } else {
    LOG_INF("Connection is broken");
  }
}

void coap_client_utils_init(/*
				ot_connection_cb_t on_connect,
			    ot_disconnection_cb_t on_disconnect,
			    mtd_mode_toggle_cb_t on_toggle
				*/)
{


  coap_init(AF_INET6, NULL);

  k_work_init(&unicast_light_work, toggle_one_light);
  k_work_init(&multicast_light_work, toggle_mesh_lights);
  k_work_init(&provisioning_work, send_provisioning_request);

  k_work_init(&genericSend_work, genericSend);
  k_work_init(&floatSend_work, floatSend);
  k_work_init(&percentageSend_work, percentageSend);
  k_work_init(&encoderSend_work, encoderSend);
  k_work_init(&commandSend_work, cmdSend);

  serverSelector = connections[0];
}

void coap_client_toggle_one_light(void) {
  submit_work_if_connected(&unicast_light_work);
}

void coap_client_toggle_mesh_lights(void) {
  submit_work_if_connected(&multicast_light_work);
}

void coap_client_send_provisioning_request(void) {
  k_work_submit(&provisioning_work);
}

void coap_client_genericSend(int server, char *msg) {
  memcpy(messagePointer, msg, GENERIC_PAYLOAD_SIZE);
  serverTarget = server;
  submit_work_if_connected(&genericSend_work);
}

void coap_client_floatSend(int server, double num) {
  memcpy(floatPointer, &num, sizeof(double));
  serverTarget = server;
  submit_work_if_connected(&floatSend_work);
}

void coap_client_toggle_minimal_sleepy_end_device(void) {
  if (IS_ENABLED(CONFIG_OPENTHREAD_MTD_SED)) {
    k_work_submit(&toggle_MTD_SED_work);
  }
}

// Added
void coap_client_percentageSend(int server, struct percentageStruct input) {
  static uint16_t counter = 0;
  for (int i = 0; i < 3; i++) {
    percentagePointer->percentages[i] =
        input.percentages[i] * (double)4294967295;
  }
  memcpy(&percentagePointer->identifier, &input.identifier, 8);
  counter++;
  serverTarget = server;
  submit_work_if_connected(&percentageSend_work);
}
void coap_client_encoderSend(int server, struct encoderMessage input) {
  static uint16_t counter = 0;
  memcpy(encoderPointer, &input, ENCODER_PAYLOAD_SIZE);
  encoderPointer->messageNum = counter;
  encoderPointer->nodeOrigin = NODE;
  counter++;
  serverTarget = server;
  submit_work_if_connected(&encoderSend_work);
}

void coap_client_cmdSend(int server, struct commandMsg input) {
  static uint16_t counter = 0;
  cmdDoMulti = -1 == server;
  memcpy(cmdPointer, &input, CMD_PAYLOAD_SIZE);
  encoderPointer->messageNum = counter;
  encoderPointer->nodeOrigin = NODE;
  counter++;
  serverTarget = server;
  submit_work_if_connected(&commandSend_work);
}
// Added/
```

## src/coap_server.c
```c
/*
 * Copyright (c) 2020 Nordic Semiconductor ASA
 *
 * SPDX-License-Identifier: LicenseRef-Nordic-5-Clause
 */

// Toggles to disable or enable functionality.
#include "coap_server_client_interface.h"
#define CLIENT
#define SERVER
//#define IMU
#define ENCODER

#include <dk_buttons_and_leds.h>
#include <openthread/thread.h>
#include <zephyr/drivers/gpio.h>
#include <zephyr/kernel.h>
#include <zephyr/logging/log.h>
#include <zephyr/net/openthread.h>
#include <zephyr/drivers/gpio.h>
#include <zephyr/drivers/uart.h> //uart
//#include <zephyr/drivers/flash.h>
// Channel management
#include <nrf_802154.h>
#include <openthread/channel_manager.h>
#include <openthread/channel_monitor.h>
#ifdef CLIENT
#include "coap_client_utils.h"
#endif
#ifdef SERVER
#include "ot_coap_utils.h"
#endif

// Control modules
#ifdef ENCODER
#include "AEDB_9140.h"
#endif
#ifdef IMU
#include "imu.h"
#endif

#include <math.h>
/* 1000 nsec = 1 usec */
//#define MIN_PER 1000000 //1 ms
#define full_length_in_steps 3000 //1 meter in motors steps is 3000, our gantry is 1 m x 1 m x 1 m
#define pi 3.14159265 //pi
#define MAXENCODER 30000.0 //1 meter in encoder steps, 30000 encoder steps = 3000 motor steps

#define RECEIVE_TIMEOUT 500 //used for reading UART inputs

bool newMessage = false;
bool mainloop = false; //Main does not start until this becomes true
bool inPrinting = false;
bool allBoardsTarget[5] = {false, false, false, false, false}; //keep track of whether or not all boards have arrived at their required targets


LOG_MODULE_REGISTER(coap_server, CONFIG_COAP_SERVER_LOG_LEVEL);
////////////////////////
//provisioning is needed to connect one board with another, however, messages can be broadcasted and received without prior pairing
#define OT_CONNECTION_LED DK_LED1
#define PROVISIONING_LED DK_LED3
#define LIGHT_LED DK_LED4
#ifdef SERVER
static struct k_work provisioning_work;

static struct k_timer led_timer;
static struct k_timer provisioning_timer;

static void on_light_request(uint8_t command) {
  static uint8_t val;
}

static void activate_provisioning(struct k_work *item) {
  ARG_UNUSED(item);

  ot_coap_activate_provisioning();

  k_timer_start(&led_timer, K_MSEC(100), K_MSEC(100));
  k_timer_start(&provisioning_timer, K_SECONDS(5), K_NO_WAIT);

  LOG_INF("Provisioning activated");
}

static void deactivate_provisionig(void) {
  k_timer_stop(&led_timer);
  k_timer_stop(&provisioning_timer);

  if (ot_coap_is_provisioning_active()) {
    ot_coap_deactivate_provisioning();
    LOG_INF("Provisioning deactivated");
  }
}

static void on_provisioning_timer_expiry(struct k_timer *timer_id) {
  ARG_UNUSED(timer_id);

  deactivate_provisionig();
}

static void on_led_timer_expiry(struct k_timer *timer_id) {
  static uint8_t val = 1;

  ARG_UNUSED(timer_id);

  dk_set_led(PROVISIONING_LED, val);
  val = !val;
}

static void on_led_timer_stop(struct k_timer *timer_id) {
  ARG_UNUSED(timer_id);

  dk_set_led_off(PROVISIONING_LED);
}
#endif


#ifdef SERVER
static void on_thread_state_changed(otChangedFlags flags,
                                    struct openthread_context *ot_context,
                                    void *user_data) {
  if (flags & OT_CHANGED_THREAD_ROLE) {
    switch (otThreadGetDeviceRole(ot_context->instance)) {
    case OT_DEVICE_ROLE_CHILD:
    case OT_DEVICE_ROLE_ROUTER:
    case OT_DEVICE_ROLE_LEADER:
      dk_set_led_on(OT_CONNECTION_LED);
      break;

    case OT_DEVICE_ROLE_DISABLED:
    case OT_DEVICE_ROLE_DETACHED:
    default:
      dk_set_led_off(OT_CONNECTION_LED);
      deactivate_provisionig();
      break;
    }
  }
}
/////////////////////////// END OF PROVISIONING STUFF
static void on_generic_request(char *msg) {//unused
  LOG_INF("Generic Request event execution!");
}

static void on_float_request(double num) { LOG_INF("Number is: %f", num); }//unused, but can be useful
static void on_percentage_request(struct percentageStruct percent) {//unused, but can be useful
  ARG_UNUSED(percent);
  LOG_INF("Percentage request callback");
}
struct encoderMessage example = {//One way of sending sensor information
      .payload = 3000, .messageNum = 0, .command = 20};

const struct device *P0 = DEVICE_DT_GET(DT_NODELABEL(gpio0));//Port for changing pins, ununsed on the CCU

//UART device obtained
const struct device *uart = DEVICE_DT_GET(DT_NODELABEL(uart0));

//Define transmission buffer (changed from 8 to 32). Not used, only for checking if uart working
static uint8_t tx_buf[] =   {"nRF Connect SDK Fundamentals Course\n\r"
                             "Press 1-3 on your keyboard to toggle LEDS 1-3 on your development kit\n\r"}; //Transmission message displayed here
//Define receive buffer and initialise it
static uint8_t rx_buf[10] = {0}; //Buffer size set to 10

int posindex = 0; //keep track of current positon

int yTarget[] = {500,1500,2500}; //unused
int xTarget[] = {500,2500,500};//unused
uint32_t RightPos = 696969;//unused, for synchronisation of RightY and LeftY motors
uint32_t LeftPos = 696969;//unused, for synchronisation of RightY and LeftY motors
int rightDir = 1;//unused, for synchronisation of RightY and LeftY motors
int leftDir = 1;//unused, for synchronisation of RightY and LeftY motors
uint8_t target[] = {71,72,73};//{75,76,77,78};// //positions to cycle through in automatic mode
#define MAXSTATES 3; //max number of positions to cycle through in automatic mode. Number of elements of 'target'
bool cycleToNew = false; //ready to move to the next target
bool presetsMode = false; //cycling through the preset positions, or not
bool canCycleToNext = true; 
bool forceCycle = false;
bool fastCycle = false;
bool syncWork = false; 
bool manualControl = false; //switch between manual control and cycling automatically through preset positions

float yTargetSteps = 1500; //target, just a placeholder

int i = 0; //counter for loops

//UART application callback function
//Check this function to see what buttonscan be pressed to do everything form the CCU
static void uart_cb(const struct device *dev, struct uart_event *evt, void *user_data)
{switch (evt->type) {
		//Only defining the receiving modes
	case UART_RX_RDY:
		if((evt->data.rx.len) == 1){ //If something entered

		//Defining responses:
		//MANUAL MODE INPUTS WASD
		if(evt->data.rx.buf[evt->data.rx.offset] == 'w'){
			LOG_DBG("Upwards \n");
			struct commandMsg example = {
			  .cmd = 0,
			  .datum1 = 101,
			  .datum2 = 101,
			  .datum3 = 0
			};
			coap_client_cmdSend(-1,example);
			//Up code uart (positive X direction in manual mode)
		}
		else if (evt->data.rx.buf[evt->data.rx.offset] == 'a'){
			LOG_DBG("Left \n");
			struct commandMsg example = {
			  .cmd = 0,
			  .datum1 = 103,
			  .datum2 = 103,
			  .datum3 = 0
			};
			coap_client_cmdSend(-1,example);
			mainloop = true;
			//Left code uart
		}
		else if (evt->data.rx.buf[evt->data.rx.offset] == 's'){
			LOG_DBG("Downwards \n");
			struct commandMsg example = {
			  .cmd = 0,
			  .datum1 = 102,
			  .datum2 = 102,
			  .datum3 = 0
			};
			coap_client_cmdSend(-1,example);
		}
		else if (evt->data.rx.buf[evt->data.rx.offset] == 'd'){
			LOG_DBG("Right \n");
			struct commandMsg example = {
			  .cmd = 0,
			  .datum1 = 104,
			  .datum2 = 104,
			  .datum3 = 0
			};
			coap_client_cmdSend(-1,example);
			//Right code uart
		}
		else if (evt->data.rx.buf[evt->data.rx.offset] == 'f'){
			LOG_DBG("Stay \n");
			struct commandMsg example = {
			  .cmd = 0,
			  .datum1 = 105,
			  .datum2 = 105,
			  .datum3 = 0
			};
			coap_client_cmdSend(-1,example);
			//Stay Still code uart
		}
		//END OF MANUAL MODE INPUTS WASD
		else if (evt->data.rx.buf[evt->data.rx.offset] == 'm'){
			manualControl = !manualControl;
			LOG_DBG("Switch to manual = %d\n",manualControl);
			struct commandMsg example = {
			  .cmd = 0,
			  .datum1 = 106,
			  .datum2 = 106,
			  .datum3 = manualControl
			};
			coap_client_cmdSend(-1,example);
			//Switch between manual or automatic by inputting m
		}
		else if (evt->data.rx.buf[evt->data.rx.offset] == 'e'){
			LOG_DBG("Target to 500");
			yTargetSteps = 500;
			// struct encoderMessage example = {.payload = yTargetSteps,
			// .messageNum=0,.command=70};
			// coap_client_encoderSend(1,example);
			struct commandMsg example = {
			  .cmd = 0,
			  .datum1 = 70,
			  .datum2 = yTargetSteps,
			  .datum3 = 0
			};
			coap_client_cmdSend(-1,example);
			//Target a preset point of (500,500)
		}
		else if (evt->data.rx.buf[evt->data.rx.offset] == 'n'){
			fastCycle = !fastCycle;
			LOG_DBG("Fast cycling = %d\n",fastCycle);
			//make the board cycle between the points faster
		}
		else if (evt->data.rx.buf[evt->data.rx.offset] == 'q'){
			LOG_DBG("Target to 2500");
			yTargetSteps = 2500;
			// struct encoderMessage example = {.payload = yTargetSteps,
			// .messageNum=0,.command=70};
			// coap_client_encoderSend(1,example);
			struct commandMsg example = {
			  .cmd = 0,
			  .datum1 = 70,
			  .datum2 = yTargetSteps,
			  .datum3 = 0
			};
			coap_client_cmdSend(-1,example);
			//Target a preset point of (2500,2500)
		}
		else if (evt->data.rx.buf[evt->data.rx.offset] == 't'){
			LOG_DBG("Target 0 \n");
			yTargetSteps = 0;
			struct commandMsg example = {
			  .cmd = 0,
			  .datum1 = 70,
			  .datum2 = yTargetSteps,
			  .datum3 = 0
			};
			coap_client_cmdSend(-1,example);
			//Target a preset point of (0,0), that is come back to initial position
		}
		else if (evt->data.rx.buf[evt->data.rx.offset] == 'b'){
			LOG_DBG("Target middle \n");
			yTargetSteps = 1500;
			struct commandMsg example = {
			  .cmd = 0,
			  .datum1 = 70,
			  .datum2 = yTargetSteps,
			  .datum3 = 0
			};
			coap_client_cmdSend(-1,example);
			////Target a preset point of (1500,1500)
		}
		else if (evt->data.rx.buf[evt->data.rx.offset] == 'x'){
			LOG_DBG("No more main");
			struct commandMsg example = {
			  .cmd = 0,
			  .datum1 = 66,
			  .datum2 = 0,
			  .datum3 = 0
			};
			coap_client_cmdSend(-1,example);
			mainloop = false;
			//Tell all boards to stop operation
		}
		else if (evt->data.rx.buf[evt->data.rx.offset] == 'r'){
			resetPosition(0);
			LOG_DBG("Reset position to 0");
			struct commandMsg example = {
			  .cmd = 0,
			  .datum1 = 67,
			  .datum2 = 0,
			  .datum3 = 0
			};
			coap_client_cmdSend(-1,example);
			//Calibrate all boards to consider current position is the (0,0) position
		}
		else if (evt->data.rx.buf[evt->data.rx.offset] == ' '){
			LOG_DBG("Asking to print Details");
			struct commandMsg example = {
			  .cmd = 0,
			  .datum1 = 68,
			  .datum2 = 0,
			  .datum3 = 0
			};
			coap_client_cmdSend(-1,example);
			//ask all nodes to output useful information for debugging
		}
		else if (evt->data.rx.buf[evt->data.rx.offset] == 'p'){
			presetsMode = !presetsMode;
			LOG_DBG("Presets mode is now %d",presetsMode);
			//change between just inputing targets and automatic cycling through said targets
		}
		else if (evt->data.rx.buf[evt->data.rx.offset] == '1'){
			LOG_DBG("All start\n");
			struct commandMsg example = {
			  .cmd = 0,
			  .datum1 = 69,
			  .datum2 = yTargetSteps,
			  .datum3 = 0
			};
			coap_client_cmdSend(-1,example);
			mainloop = true;
			//Send the message to start the main loop of every node
		}
		else if (evt->data.rx.buf[evt->data.rx.offset] == '2'){
			coap_client_send_provisioning_request();
			//send a provisioning request for pairing
		}
		else if (evt->data.rx.buf[evt->data.rx.offset] == '3'){
			serverScroll();
			//changes who to send messages to
		}
		else if (evt->data.rx.buf[evt->data.rx.offset] == '4'){
			k_work_submit(&provisioning_work);
			//check if received a provisioning request for pairing
		}
		else if (evt->data.rx.buf[evt->data.rx.offset] == '5'){
			struct commandMsg example = {
			  .cmd = 0,
			  .datum1 = 71,
			  .datum2 = yTargetSteps,
			  .datum3 = 0
			};
			coap_client_cmdSend(-1,example);
			//move to preset position 71
		}
		else if (evt->data.rx.buf[evt->data.rx.offset] == '6'){
			struct commandMsg example = {
			  .cmd = 0,
			  .datum1 = 72,
			  .datum2 = yTargetSteps,
			  .datum3 = 0
			};
			coap_client_cmdSend(-1,example);
			//move to preset position 72
		}
		else if (evt->data.rx.buf[evt->data.rx.offset] == '7'){
			struct commandMsg example = {
			  .cmd = 0,
			  .datum1 = 73,
			  .datum2 = yTargetSteps,
			  .datum3 = 0
			};
			coap_client_cmdSend(-1,example);
			//move to preset position 73
		}
		}

        break;
	case UART_RX_DISABLED: //Constant receiving
		uart_rx_enable(dev ,rx_buf,sizeof rx_buf,RECEIVE_TIMEOUT);
		break;
		
	default:
		break;
	}
}

void fast_work_handler(struct k_work *work) //cycle quickly through the presets. Only if set to true by inputting 'n' on uart
{
	canCycleToNext = true;
	cycleToNew = true;
}
K_WORK_DEFINE(fast_work, fast_work_handler);

void fast_timer_handler(struct k_timer *timer_id)
{
	k_work_submit(&fast_work);
}
K_TIMER_DEFINE(fast_timer, fast_timer_handler, NULL); //set a timer to cycle between the presets

void wait_work_handler(struct k_work *work) //wait for a certain time after sending a new target before checking if it has been achieved
{
	LOG_DBG("I have allowed the change to the next pattern");
	canCycleToNext = true;
	// if(fastCycle){
	// 	k_timer_start(&fast_timer,K_MSEC(2000),K_FOREVER);
	// }
}
K_WORK_DEFINE(wait_work, wait_work_handler);

void wait_timer_handler(struct k_timer *timer_id)
{
	k_work_submit(&wait_work);
}
K_TIMER_DEFINE(wait_timer, wait_timer_handler, NULL);

struct encoderMessage currentEncode = {}; //encoder information message sending
static void on_encoder_request(struct encoderMessage encode) {
  //LOG_DBG("Message Number: %i\nPosition:%i,Velocity:%i",encode.messageNum,encode.position,encode.velocity);
  //LOG_DBG("Encoder request callback!");
	if (currentEncode.messageNum + 1 != encode.messageNum) { //see how many messages have been dropped
		LOG_INF("Dropped %d!", encode.messageNum - currentEncode.messageNum + 1);
	}
	currentEncode = encode; //update the currentEncode variable
	if(currentEncode.command == 69){ //if the message carries certain commands, execute them
		mainloop = true; //command 69 starts the main loop of a node
	}
	if(currentEncode.command == 70){  //command 70 changes the target of a node
		yTargetSteps = currentEncode.payload;
	}
	newMessage = true;
}

static void on_cmd_request(struct commandMsg cmd) {
	switch(cmd.datum1){
		case 1: //case 1 is for synchronisation between Right and Left motors. Unused right now
			LOG_DBG("Received message with %d and %d and %d",cmd.datum1,cmd.datum2,cmd.datum3);
			if(cmd.datum3 == RIGHTY){
				RightPos = cmd.datum2;
				if(cmd.cmd == (uint8_t) -1){
					rightDir = -1;
				}
				else{
					rightDir = 1;
				}
			}
			if(cmd.datum3 == LEFTY){
				LeftPos = cmd.datum2;
				if(cmd.cmd == (uint8_t) -1){
					leftDir = -1;
				}
				else{
					leftDir = 1;
				}
			}
			if((RightPos < 696969) && (LeftPos < 696969)){
				LOG_DBG("Gonna Sync them");
				syncWork = true;
			}
			break;
		case 2:
			
			break;
		case 69: //case 69 is for starting a node. Unused on the CCU
			mainloop = true;
			break;
		case 70: //case 70 is for changing the target of the node to datum2. Unused on the CCU
			yTargetSteps = cmd.datum2;
			break;
		case 100: //if received message from node that it has reached the target, see if all nodes reached the target and move to the next position if yes
			if(NODE == CCU){
				allBoardsTarget[cmd.datum3] = true;
				LOG_DBG("Board Number %d has arrived",cmd.datum3);
				if(allBoardsTarget[MIDX] && allBoardsTarget[LEFTY] && allBoardsTarget[RIGHTY]){
					if(canCycleToNext){
						cycleToNew = true;
						canCycleToNext = false;
						k_timer_start(&wait_timer,K_MSEC(2000),K_FOREVER);
					}
			}
			}
			
		default:
		break;
}
}
//openthread functions
static struct openthread_state_changed_cb ot_state_chaged_cb = {
    .state_changed_cb = on_thread_state_changed};
#endif

static void on_button_changed(uint32_t button_state, uint32_t has_changed) {
  uint32_t buttons = button_state & has_changed;
#ifdef SERVER
  if (buttons & DK_BTN4_MSK) {
    k_work_submit(&provisioning_work);
  }
#endif
#ifdef CLIENT
  if (buttons & DK_BTN3_MSK) {
    // Should toggle through server selected.
    //serverScroll();
	 struct encoderMessage example = {.payload = 3000,
      .messageNum=0,.command=69};
    coap_client_encoderSend(1,example);
	mainloop = true;
  }
  if (buttons & DK_BTN2_MSK) {
    // Should send a provisioning request.
    coap_client_send_provisioning_request();
  }
  if (buttons & DK_BTN1_MSK) {
    // coap_client_toggle_one_light();
    //coap_client_floatSend(10.768);
    /*
    struct percentageStruct example = {.percentages = {1.0,1.0,1.0},
      .identifier = "Hello!"};
    coap_client_percentageSend(example);
    */
    mainloop = true;
  }
#endif
}


void main(void)
{
    // Need to sleep at start for logs to display correctly.
  k_msleep(1000);
#ifdef SERVER
//initialise openthread functions
  int ret;

  LOG_INF("Start CoAP-server sample with Node %d",NODE);

  k_timer_init(&led_timer, on_led_timer_expiry, on_led_timer_stop);
  k_timer_init(&provisioning_timer, on_provisioning_timer_expiry, NULL);

  k_work_init(&provisioning_work, activate_provisioning);

  ret = ot_coap_init(&deactivate_provisionig, &on_light_request,
                     &on_generic_request, &on_float_request,
                     &on_percentage_request, &on_encoder_request, &on_cmd_request);
  if (ret) {
    LOG_ERR("Could not initialize OpenThread CoAP");
    goto end;
  }


  ret = dk_leds_init();
  if (ret) {
    LOG_ERR("Could not initialize leds, err code: %d", ret);
    goto end;
  }

  ret = dk_buttons_init(on_button_changed);
  if (ret) {
    LOG_ERR("Cannot init buttons (error: %d)", ret);
    goto end;
  }

  openthread_state_changed_cb_register(openthread_get_default_context(),
                                       &ot_state_chaged_cb);
  openthread_start(openthread_get_default_context());

  LOG_DBG("Passed openthread_start in main!");
#endif
#ifdef CLIENT
  coap_client_utils_init();
  LOG_DBG("Passed client start in main!");
#endif /* ifdef CLIENT */

	if (!device_is_ready(P0)) {
		return;
	}

	//UART callback function registered
	ret = uart_callback_set(uart, uart_cb, NULL);
		if (ret) {
			return;
		}
	//Data sent over UART
	ret = uart_tx(uart, tx_buf, sizeof(tx_buf), SYS_FOREVER_US);
	if (ret) {
		return;
	}	
	//uart_rx_enable() call to start receiving
	ret = uart_rx_enable(uart ,rx_buf,sizeof rx_buf,RECEIVE_TIMEOUT);
	if (ret) {
		return;
	}

	printk("Uart is setup \n");

	printk("Control Wirelessly Correct\n");
	k_sleep(K_NSEC(2000U*1000U*1000U));


	//The CCU does not do anything in MAIN besides waiting for data form the motor actuating nodes and sending them targets or receiving their positons.
	while (1) {		
		//delta_phi = delta_phi_start/scalar;
		if(cycleToNew && presetsMode){ //if it shoudl move to the next target, send the message to move to the next target
			k_sleep(K_MSEC(200));
			posindex = (posindex+1)%MAXSTATES; //index of next target
			LOG_DBG("Cycling to pos %d",posindex);
			k_sleep(K_USEC(300));
			struct commandMsg example = {
			.cmd = 0,
			.datum1 = target[posindex], //will be a number like 71, 72 or 73, each corresponding to a agreed position
			.datum2 = 6969,
			.datum3 = 0
			};
			coap_client_cmdSend(-1,example);
			LOG_DBG("Moving to next target");
			k_sleep(K_USEC(2000));
			cycleToNew = false;
			for(i = 0; i<5; i++){
				allBoardsTarget[i] = false; //reset the fact that all boards have achieved their target
			}
			if(fastCycle){ //if fast mode. Cycle every 3 seconds, even if the target is not reached, to Show degradation with control
				k_timer_stop(&wait_timer);
				k_timer_start(&fast_timer,K_MSEC(3000),K_FOREVER);
			}
		}
		k_sleep(K_USEC(2000));
	}

  end: return;
}
```

## src/ot_coap_utils.h
```c
/*
 * Copyright (c) 2020 Nordic Semiconductor ASA
 *
 * SPDX-License-Identifier: LicenseRef-Nordic-5-Clause
 */

#ifndef __OT_COAP_UTILS_H__
#define __OT_COAP_UTILS_H__
#include <coap_server_client_interface.h>
#include <zephyr/kernel.h>

/**@brief Type definition of the function used to handle light resource change.
 */
typedef void (*light_request_callback_t)(uint8_t cmd);
typedef void (*provisioning_request_callback_t)();
// Added
typedef void (*generic_request_callback_t)(char *stringStart);
typedef void (*float_request_callback_t)(double floatNum);
typedef void (*percentage_request_callback_t)(struct percentageStruct percent);
typedef void (*encoder_request_callback_t)(struct encoderMessage encode);
typedef void (*cmd_request_callback_t)(struct commandMsg cmd);
// Added

int ot_coap_init(provisioning_request_callback_t on_provisioning_request,
                 light_request_callback_t on_light_request,
                 generic_request_callback_t on_generic_request,
                 float_request_callback_t on_float_request,
                 percentage_request_callback_t on_percentage_request,
                 encoder_request_callback_t on_encoder_request,
                 cmd_request_callback_t on_cmd_request
                 );

void ot_coap_activate_provisioning(void);

void ot_coap_deactivate_provisioning(void);

bool ot_coap_is_provisioning_active(void);

double get_double(void);
#endif
```
