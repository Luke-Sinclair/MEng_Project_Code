## prj.conf
```kconfig
#
# Copyright (c) 2020 Nordic Semiconductor
#
# SPDX-License-Identifier: LicenseRef-Nordic-5-Clause
#

# nRF board library
CONFIG_DK_LIBRARY=y

# Enable OpenThread CoAP support API
CONFIG_OPENTHREAD_COAP=y

# Network sockets
CONFIG_NET_SOCKETS=y
CONFIG_NET_SOCKETS_POSIX_NAMES=y
CONFIG_NET_SOCKETS_POLL_MAX=4

# Same network Master Key for client and server
CONFIG_OPENTHREAD_NETWORKKEY="00:11:22:33:44:55:66:77:88:99:aa:bb:cc:dd:ee:ff"

# L2 OpenThread enabling
CONFIG_NET_L2_OPENTHREAD=y

# Generic networking options
CONFIG_NETWORKING=y

CONFIG_MBEDTLS_SHA1_C=n
CONFIG_FPU=y
#My extras
CONFIG_LOG=y
CONFIG_COAP_SERVER_LOG_LEVEL_DBG=y
CONFIG_OT_COAP_UTILS_LOG_LEVEL_DBG=y

CONFIG_HEAP_MEM_POOL_SIZE=2048


CONFIG_GPIO=y
CONFIG_NEWLIB_LIBC=y
CONFIG_NEWLIB_LIBC_FLOAT_PRINTF=y
CONFIG_ENCODER_LOG_LEVEL_INF=y

# Enable channel management
CONFIG_OPENTHREAD_CHANNEL_MONITOR=y
CONFIG_OPENTHREAD_CHANNEL_MANAGER=y
# Stuff for checking which channel we're in seperately.
CONFIG_NRF_802154_RADIO_CONFIG=y
CONFIG_NRF_802154_RADIO_DRIVER=y

# Client server stuff
CONFIG_LOG=y
CONFIG_COAP_CLIENT_UTILS_LOG_LEVEL_DBG=y

# Enable CoAP utils and CoAP protocol
CONFIG_COAP_UTILS=y
```

## src/AEDB_9140.c
```c
#include "AEDB_9140.h"
#include "zephyr/kernel.h"
#include <math.h>
#include <zephyr/device.h>
#include <zephyr/drivers/gpio.h>
//#include <zephyr/logging/log.h>

//LOG_MODULE_REGISTER(encoder, CONFIG_ENCODER_LOG_LEVEL);
static const struct gpio_dt_spec ChannelA_Encoder =
    GPIO_DT_SPEC_GET(DT_NODELABEL(encodercha), gpios);
static const struct gpio_dt_spec ChannelB_Encoder =
    GPIO_DT_SPEC_GET(DT_NODELABEL(encoderchb), gpios);
static const struct gpio_dt_spec ChannelI_Encoder =
    GPIO_DT_SPEC_GET(DT_NODELABEL(encoderindex), gpios);

static struct gpio_callback encoderA_callback;
static struct gpio_callback encoderB_callback;
static struct gpio_callback encoderI_callback;

static const int QEM[4][4] = {{0, -1, 1, 2},
                              {1, 0, 2, -1},
                              {-1, 2, 0, 1},
                              {2, 1, -1, 0}}; // Quadrature Encoder Matrix
int state = 0;
int oldState = 0;
int32_t position = 0;
int32_t position_prevfullrev = 0;
int32_t FullResolutionPositionCount = 0;
int32_t intVel = 0;
float floatVel = 0.0f;
int32_t intAcc = 0;
float floatAcc = 0.0f;

int aState = 0;
int bState = 0;

int32_t getIntVel(void) { return intVel; }
float getFloatVel(void) { return floatVel; }
int32_t getIntAcc(void) { return intAcc; }
float getFloatAcc(void) { return floatAcc; }

void setPosition(struct k_work *work) {
  static int oldState = 0;
  state = (bState << 1) + aState;
  position += QEM[state][oldState];
  oldState = state;
}
K_WORK_DEFINE(setPosition_work, setPosition);
void aChange() {
  aState = gpio_pin_get_dt(&ChannelA_Encoder);
  k_work_submit(&setPosition_work);
}
void bChange() {
  bState = gpio_pin_get_dt(&ChannelB_Encoder);
  k_work_submit(&setPosition_work);
}

void FullRotationCounter() {
  FullResolutionPositionCount = position - position_prevfullrev;
  position_prevfullrev = position;
}

void measure(struct k_work *work) {
  static uint8_t count = 0;
  setVelocity();
  if (count % 2 == 0) {
    setAcceleration();
  }
}
K_WORK_DEFINE(measure_work, measure);

void measureInterrupt(struct k_timer *timer_id) {
  k_work_submit(&measure_work);
}
K_TIMER_DEFINE(measureTime, measureInterrupt, NULL);

void Setup_interrupt(void) {
  gpio_pin_interrupt_configure_dt(&ChannelA_Encoder, GPIO_INT_EDGE_BOTH);
  gpio_pin_interrupt_configure_dt(&ChannelB_Encoder, GPIO_INT_EDGE_BOTH);
  gpio_init_callback(&encoderA_callback, aChange, BIT(ChannelA_Encoder.pin));
  gpio_add_callback(ChannelA_Encoder.port, &encoderA_callback);
  gpio_init_callback(&encoderB_callback, bChange, BIT(ChannelB_Encoder.pin));
  gpio_add_callback(ChannelB_Encoder.port, &encoderB_callback);
  k_timer_start(&measureTime, K_SECONDS(0), K_MSEC(ENCODER_SAMPLE_PERIOD_MS));
}

void resetPosition(int32_t in) { position = in; return; }

int32_t getPosition(void) { return position; }

// Should be called every period.
void setVelocity(void) {
  static int32_t previousPosition = 0;
  intVel = position - previousPosition;
  floatVel =
      (float)intVel * (40.85E-6) / (float)ENCODER_SAMPLE_PERIOD_MS * 1000.0f;
  previousPosition = position;
}
// Should be called every 3rd period.
void setAcceleration(void) {
  static int32_t previousVelocity = 0;
  static float previousFloatVel = 0;
  intAcc = intVel - previousVelocity;
  floatAcc = (floatVel - previousFloatVel) / (float)ENCODER_SAMPLE_PERIOD_MS /
             3.0f * 1000.0f;
  previousVelocity = intVel;
  previousFloatVel = floatVel;
}

void encoderTestLoop(void) {
  for (int i = 1;; i++) {
    k_msleep((int32_t)(ENCODER_SAMPLE_PERIOD_MS * 1000.0f));
    LOG_DBG("Pos: %d, Vel: %.3f, Acc: %3f\n", getPosition(), getFloatVel(),
            getFloatAcc());
    k_msleep((int32_t)(ENCODER_SAMPLE_PERIOD_MS));
    setVelocity();
    if (i % 3 == 0) {
      setAcceleration();
      i = 0;
    }
  }
}
```

## src/coap_client_utils.c
```c
/*
 * Copyright (c) 2020 Nordic Semiconductor ASA
 *
 * SPDX-License-Identifier: LicenseRef-Nordic-5-Clause
 */

#include "coap_server_client_interface.h"
#include <net/coap_utils.h>
#include <openthread/thread.h>
#include <string.h>
#include <sys/_stdint.h>
#include <zephyr/logging/log.h>
#include <zephyr/net/openthread.h>
#include <zephyr/net/socket.h>

#include "coap_client_utils.h"
#include "node.h"
#include "zephyr/kernel.h"
#include "zephyr/net/coap.h"

LOG_MODULE_REGISTER(coap_client_utils, CONFIG_COAP_CLIENT_UTILS_LOG_LEVEL);

// How often client will poll for response.
#define RESPONSE_POLL_PERIOD 100

static int serverSelector = 0;
static int connectSelector = 0;
static int serverTarget = 0;

static uint32_t poll_period;

static bool is_connected[6];
CONNECTIONS();

static struct k_work unicast_light_work;
static struct k_work multicast_light_work;
static struct k_work toggle_MTD_SED_work;
static struct k_work provisioning_work;

static struct k_work genericSend_work;
static struct k_work floatSend_work;
static struct k_work percentageSend_work;
static struct k_work encoderSend_work;
static struct k_work commandSend_work;

// Must point to something of size GENERIC_PAYLOAD_SIZE
static char messagePointer[GENERIC_PAYLOAD_SIZE] = {};
static struct encoderMessage encoderPointer[1] = {};

static double floatPointer[1] = {};

static struct percentageStructHidden percentagePointer[1] = {};
static struct commandMsg cmdPointer[1] = {};
static int cmdDoMulti = 0;

mtd_mode_toggle_cb_t on_mtd_mode_toggle;

/* Options supported by the server */
static const char *const light_option[] = {LIGHT_URI_PATH, NULL};
static const char *const provisioning_option[] = {PROVISIONING_URI_PATH, NULL};
static const char *const generic_option[] = {GENERIC_URI_PATH, NULL};
static const char *const float_option[] = {FLOAT_URI_PATH, NULL};
static const char *const percentage_option[] = {PERCENTAGE_URI_PATH, NULL};
static const char *const encoder_option[] = {ENCODER_URI_PATH, NULL};
static const char *const cmd_option[] = {CMD_URI_PATH, NULL};

/* Thread multicast mesh local address */
static struct sockaddr_in6 multicast_local_addr = {
    .sin6_family = AF_INET6,
    .sin6_port = htons(COAP_PORT),
    .sin6_addr.s6_addr = {0xff, 0x03, 0x00, 0x00, 0x00, 0x00, 0x00, 0x00, 0x00,
                          0x00, 0x00, 0x00, 0x00, 0x00, 0x00, 0x01},
    .sin6_scope_id = 0U};

/* Variable for storing server address acquiring in provisioning handshake */
static char unique_local_addr_str[6][INET6_ADDRSTRLEN];
static struct sockaddr_in6 unique_local_addr[6] = {
    {.sin6_family = AF_INET6,
     .sin6_port = htons(COAP_PORT),
     .sin6_addr.s6_addr =
         {
             0,
         },
     .sin6_scope_id = 0U},
    {.sin6_family = AF_INET6,
     .sin6_port = htons(COAP_PORT),
     .sin6_addr.s6_addr =
         {
             0,
         },
     .sin6_scope_id = 0U},
    {.sin6_family = AF_INET6,
     .sin6_port = htons(COAP_PORT),
     .sin6_addr.s6_addr =
         {
             0,
         },
     .sin6_scope_id = 0U},
    {.sin6_family = AF_INET6,
     .sin6_port = htons(COAP_PORT),
     .sin6_addr.s6_addr =
         {
             0,
         },
     .sin6_scope_id = 0U},
    {.sin6_family = AF_INET6,
     .sin6_port = htons(COAP_PORT),
     .sin6_addr.s6_addr =
         {
             0,
         },
     .sin6_scope_id = 0U},
    {.sin6_family = AF_INET6,
     .sin6_port = htons(COAP_PORT),
     .sin6_addr.s6_addr =
         {
             0,
         },
     .sin6_scope_id = 0U}};

// Added
void serverScroll(void) {
  connectSelector++;
  connectSelector = connectSelector % SERVERS;
  serverSelector = connections[connectSelector];
  LOG_INF("Server %i | On? %i | Addr %s", serverSelector,
          is_connected[serverSelector], unique_local_addr_str[serverSelector]);
}
// Added/

static bool is_mtd_in_med_mode(otInstance *instance) {
  return otThreadGetLinkMode(instance).mRxOnWhenIdle;
}

static void poll_period_response_set(void) {
  otError error;

  otInstance *instance = openthread_get_default_instance();

  if (is_mtd_in_med_mode(instance)) {
    return;
  }

  if (!poll_period) {
    poll_period = otLinkGetPollPeriod(instance);

    error = otLinkSetPollPeriod(instance, RESPONSE_POLL_PERIOD);
    __ASSERT(error == OT_ERROR_NONE, "Failed to set pool period");

    LOG_INF("Poll Period: %dms set", RESPONSE_POLL_PERIOD);
  }
}

static void poll_period_restore(void) {
  otError error;
  otInstance *instance = openthread_get_default_instance();

  if (is_mtd_in_med_mode(instance)) {
    return;
  }

  if (poll_period) {
    error = otLinkSetPollPeriod(instance, poll_period);
    __ASSERT_NO_MSG(error == OT_ERROR_NONE);

    LOG_INF("Poll Period: %dms restored", poll_period);
    poll_period = 0;
  }
}

static int on_provisioning_reply(const struct coap_packet *response,
                                 struct coap_reply *reply,
                                 const struct sockaddr *from) {
  int ret = 0;
  const uint8_t *payload;
  uint16_t payload_size = 0u;

  ARG_UNUSED(reply);
  ARG_UNUSED(from);

  payload = coap_packet_get_payload(response, &payload_size);

  if (payload == NULL ||
      payload_size != sizeof(unique_local_addr[serverSelector].sin6_addr)) {
    LOG_ERR("Received data is invalid");
    ret = -EINVAL;
    goto exit;
  }

  memcpy(&unique_local_addr[serverSelector].sin6_addr, payload, payload_size);

  if (!inet_ntop(AF_INET6, payload, unique_local_addr_str[serverSelector],
                 INET6_ADDRSTRLEN)) {
    LOG_ERR("Received data is not IPv6 address: %d", errno);
    ret = -errno;
    goto exit;
  }

  LOG_INF("Received peer address: %s for %d",
          unique_local_addr_str[serverSelector], serverSelector);

exit:
  if (IS_ENABLED(CONFIG_OPENTHREAD_MTD_SED)) {
    poll_period_restore();
  }

  return ret;
}

static void toggle_one_light(struct k_work *item) {
  uint8_t payload = (uint8_t)THREAD_COAP_UTILS_LIGHT_CMD_TOGGLE;

  ARG_UNUSED(item);

  if (unique_local_addr[serverSelector].sin6_addr.s6_addr16[0] == 0) {
    LOG_WRN("Peer address not set. Activate 'provisioning' option "
            "on the server side");
    return;
  }

  LOG_INF("Send 'light' request to: %s", unique_local_addr_str[serverSelector]);
  coap_send_request(COAP_METHOD_PUT,
                    (const struct sockaddr *)&unique_local_addr[serverSelector],
                    light_option, &payload, sizeof(payload), NULL);
}

static void toggle_mesh_lights(struct k_work *item) {
  static uint8_t command = (uint8_t)THREAD_COAP_UTILS_LIGHT_CMD_OFF;

  ARG_UNUSED(item);

  command = ((command == THREAD_COAP_UTILS_LIGHT_CMD_OFF)
                 ? THREAD_COAP_UTILS_LIGHT_CMD_ON
                 : THREAD_COAP_UTILS_LIGHT_CMD_OFF);

  LOG_INF("Send multicast mesh 'light' request");
  coap_send_request(COAP_METHOD_PUT,
                    (const struct sockaddr *)&multicast_local_addr,
                    light_option, &command, sizeof(command), NULL);
}

static void send_provisioning_request(struct k_work *item) {
  ARG_UNUSED(item);

  if (IS_ENABLED(CONFIG_OPENTHREAD_MTD_SED)) {
    /* decrease the polling period for higher responsiveness */
    poll_period_response_set();
  }

  LOG_INF("Send 'provisioning' request");
  coap_send_request(COAP_METHOD_GET,
                    (const struct sockaddr *)&multicast_local_addr,
                    provisioning_option, NULL, 0u, on_provisioning_reply);
}
// Added
static void genericSend(struct k_work *item) {
  ARG_UNUSED(item);

  LOG_DBG("Generic send to %s", unique_local_addr_str[serverTarget]);

  if (coap_send_request(
          COAP_METHOD_PUT,
          (const struct sockaddr *)&unique_local_addr[serverTarget],
          generic_option, messagePointer, GENERIC_PAYLOAD_SIZE, NULL) >= 0) {

    LOG_DBG("Generic message send success!\n%s", messagePointer);
  } else {
    LOG_DBG("Generic message send fail.\n%s", messagePointer);
  }
}
static void floatSend(struct k_work *item) {
  ARG_UNUSED(item);
  LOG_DBG("Float send to %s", unique_local_addr_str[serverTarget]);
  if (coap_send_request(
          COAP_METHOD_PUT,
          (const struct sockaddr *)&unique_local_addr[serverTarget],
          float_option, (char *)floatPointer, sizeof(double), NULL) >= 0) {

    LOG_DBG("Float message send success!\n%.3f", *floatPointer);
  } else {
    LOG_DBG("Float message send fail.\n%.3f", *floatPointer);
  }
}
static void percentageSend(struct k_work *item) {
  ARG_UNUSED(item);
  if (coap_send_request(
          COAP_METHOD_PUT,
          (const struct sockaddr *)&unique_local_addr[serverTarget],
          percentage_option, (char *)percentagePointer, PERCENTAGE_PAYLOAD_SIZE,
          NULL) >= 0) {
    LOG_DBG("Percentage message send success!\n%s",
            percentagePointer->identifier);
  } else {
    LOG_DBG("Percentage message send fail.\n%s", percentagePointer->identifier);
  }
}
static void encoderSend(struct k_work *item) {
  ARG_UNUSED(item);
  if (coap_send_request(
          COAP_METHOD_PUT,
          (const struct sockaddr *)&unique_local_addr[serverTarget],
          encoder_option, (char *)encoderPointer, ENCODER_PAYLOAD_SIZE,
          NULL) >= 0) {
    LOG_DBG("Encoder message send success!\n");
  } else {
    LOG_DBG("Encoder message send fail!\n");
  }
}
static void cmdSend(struct k_work *item) {
  const struct sockaddr *address;
  if (cmdDoMulti) {
    address = (const struct sockaddr *)&multicast_local_addr;
  } else {
    address = (const struct sockaddr *)&unique_local_addr[serverTarget];
  }
  ARG_UNUSED(item);
  if (coap_send_request(COAP_METHOD_PUT, address, cmd_option,
                        (char *)cmdPointer, CMD_PAYLOAD_SIZE, NULL) >= 0) {
    LOG_DBG("Cmd message send success!\n");
  } else {
    LOG_DBG("Cmd message send fail!\n");
  }
}
// Added/

static void submit_work_if_connected(struct k_work *work) {
  //  if (is_connected[serverTarget]) {
  if (serverTarget == -1) {
    LOG_DBG("Multicast Target!");
  } else {
    LOG_DBG("Target is %d AKA %s", serverTarget,
            unique_local_addr_str[serverTarget]);
  }
  if (true) {
    k_work_submit(work);
  } else {
    LOG_INF("Connection is broken");
  }
}

// Don't need on connection/toggles because server code handles light on joint
// node.
void coap_client_utils_init(/*
				ot_connection_cb_t on_connect,
			    ot_disconnection_cb_t on_disconnect,
			    mtd_mode_toggle_cb_t on_toggle
				*/)
{
  // on_mtd_mode_toggle = on_toggle;

  coap_init(AF_INET6, NULL);

  // k_work_init(&on_connect_work, on_connect);
  // k_work_init(&on_disconnect_work, on_disconnect);
  k_work_init(&unicast_light_work, toggle_one_light);
  k_work_init(&multicast_light_work, toggle_mesh_lights);
  k_work_init(&provisioning_work, send_provisioning_request);

  k_work_init(&genericSend_work, genericSend);
  k_work_init(&floatSend_work, floatSend);
  k_work_init(&percentageSend_work, percentageSend);
  k_work_init(&encoderSend_work, encoderSend);
  k_work_init(&commandSend_work, cmdSend);

  // openthread_state_changed_cb_register(openthread_get_default_context(),
  // &ot_state_chaged_cb); openthread_start(openthread_get_default_context());
  /*
  if (IS_ENABLED(CONFIG_OPENTHREAD_MTD_SED)) {
          k_work_init(&toggle_MTD_SED_work,
                      toggle_minimal_sleepy_end_device);
          update_device_state();
  }
  */
  serverSelector = connections[0];
}

void coap_client_toggle_one_light(void) {
  submit_work_if_connected(&unicast_light_work);
}

void coap_client_toggle_mesh_lights(void) {
  submit_work_if_connected(&multicast_light_work);
}

void coap_client_send_provisioning_request(void) {
  k_work_submit(&provisioning_work);
}

void coap_client_genericSend(int server, char *msg) {
  memcpy(messagePointer, msg, GENERIC_PAYLOAD_SIZE);
  serverTarget = server;
  submit_work_if_connected(&genericSend_work);
}

void coap_client_floatSend(int server, double num) {
  memcpy(floatPointer, &num, sizeof(double));
  serverTarget = server;
  submit_work_if_connected(&floatSend_work);
}

void coap_client_toggle_minimal_sleepy_end_device(void) {
  if (IS_ENABLED(CONFIG_OPENTHREAD_MTD_SED)) {
    k_work_submit(&toggle_MTD_SED_work);
  }
}
void coap_client_percentageSend(int server, struct percentageStruct input) {
  static uint16_t counter = 0;
  for (int i = 0; i < 3; i++) {
    percentagePointer->percentages[i] =
        input.percentages[i] * (double)4294967295;
  }
  memcpy(&percentagePointer->identifier, &input.identifier, 8);
  counter++;
  serverTarget = server;
  submit_work_if_connected(&percentageSend_work);
}
void coap_client_encoderSend(int server, struct encoderMessage input) {
  static uint16_t counter = 0;
  memcpy(encoderPointer, &input, ENCODER_PAYLOAD_SIZE);
  encoderPointer->messageNum = counter;
  encoderPointer->nodeOrigin = NODE;
  counter++;
  serverTarget = server;
  submit_work_if_connected(&encoderSend_work);
}

void coap_client_cmdSend(int server, struct commandMsg input) {
  static uint16_t counter = 0;
  cmdDoMulti = -1 == server;
  memcpy(cmdPointer, &input, CMD_PAYLOAD_SIZE);
  encoderPointer->messageNum = counter;
  encoderPointer->nodeOrigin = NODE;
  counter++;
  serverTarget = server;
  submit_work_if_connected(&commandSend_work);
}
```

## src/ot_coap_utils.c
```c
/*
 * Copyright (c) 2020 Nordic Semiconductor ASA
 *
 * SPDX-License-Identifier: LicenseRef-Nordic-5-Clause
 */

#include <openthread/coap.h>
#include <openthread/ip6.h>
#include <openthread/message.h>
#include <openthread/thread.h>
#include <zephyr/logging/log.h>
#include <zephyr/net/net_l2.h>
#include <zephyr/net/net_pkt.h>
#include <zephyr/net/openthread.h>
#include <zephyr/net/socket.h>

#include "coap_server_client_interface.h"
#include "ot_coap_utils.h"

#include <net/coap_utils.h>

LOG_MODULE_REGISTER(ot_coap_utils, CONFIG_OT_COAP_UTILS_LOG_LEVEL);

double message_double;
bool val=false;

struct server_context {
  struct otInstance *ot;
  bool provisioning_enabled;
  light_request_callback_t on_light_request;
  provisioning_request_callback_t on_provisioning_request;
  generic_request_callback_t on_generic_request;
  float_request_callback_t on_float_request;
  percentage_request_callback_t on_percentage_request;
  encoder_request_callback_t on_encoder_request;
  cmd_request_callback_t on_cmd_request;
};

static struct server_context srv_context = {
    .ot = NULL,
    .provisioning_enabled = false,
    .on_light_request = NULL,
    .on_provisioning_request = NULL,
    .on_generic_request = NULL,
    .on_encoder_request = NULL,
};

/**@brief Definition of CoAP resources for provisioning. */
static otCoapResource provisioning_resource = {
    .mUriPath = PROVISIONING_URI_PATH,
    .mHandler = NULL,
    .mContext = NULL,
    .mNext = NULL,
};

/**@brief Definition of CoAP resources for light. */
static otCoapResource light_resource = {
    .mUriPath = LIGHT_URI_PATH,
    .mHandler = NULL,
    .mContext = NULL,
    .mNext = NULL,
};

static otCoapResource generic_resource = {.mUriPath = GENERIC_URI_PATH,
                                          .mHandler = NULL,
                                          .mContext = NULL,
                                          .mNext = NULL};

static otCoapResource float_resource = {.mUriPath = FLOAT_URI_PATH,
                                        .mHandler = NULL,
                                        .mContext = NULL,
                                        .mNext = NULL};
static otCoapResource percentage_resource = {.mUriPath = PERCENTAGE_URI_PATH,
                                        .mHandler = NULL,
                                        .mContext = NULL,
                                        .mNext = NULL};
static otCoapResource encoder_resource = {.mUriPath = ENCODER_URI_PATH,
                                        .mHandler = NULL,
                                        .mContext = NULL,
                                        .mNext = NULL};
static otCoapResource cmd_resource = {.mUriPath = CMD_URI_PATH,
                                        .mHandler = NULL,
                                        .mContext = NULL,
                                        .mNext = NULL};

static otError provisioning_response_send(otMessage *request_message,
                                          const otMessageInfo *message_info) {
  otError error = OT_ERROR_NO_BUFS;
  otMessage *response;
  const void *payload;
  uint16_t payload_size;

  response = otCoapNewMessage(srv_context.ot, NULL);
  if (response == NULL) {
    goto end;
  }

  otCoapMessageInit(response, OT_COAP_TYPE_NON_CONFIRMABLE,
                    OT_COAP_CODE_CONTENT);

  error =
      otCoapMessageSetToken(response, otCoapMessageGetToken(request_message),
                            otCoapMessageGetTokenLength(request_message));
  if (error != OT_ERROR_NONE) {
    goto end;
  }

  error = otCoapMessageSetPayloadMarker(response);
  if (error != OT_ERROR_NONE) {
    goto end;
  }

  payload = otThreadGetMeshLocalEid(srv_context.ot);
  payload_size = sizeof(otIp6Address);

  error = otMessageAppend(response, payload, payload_size);
  if (error != OT_ERROR_NONE) {
    goto end;
  }

  // Sends response back as a return
  error = otCoapSendResponse(srv_context.ot, response, message_info);

  LOG_HEXDUMP_INF(payload, payload_size, "Sent provisioning response:");

end:
  if (error != OT_ERROR_NONE && response != NULL) {
    otMessageFree(response);
  }

  return error;
}

static void provisioning_request_handler(void *context, otMessage *message,
                                         const otMessageInfo *message_info) {
  otError error;
  otMessageInfo msg_info;

  ARG_UNUSED(context);

  if (!srv_context.provisioning_enabled) {
    LOG_WRN("Received provisioning request but provisioning "
            "is disabled");
    return;
  }

  LOG_INF("Received provisioning request");

  if ((otCoapMessageGetType(message) == OT_COAP_TYPE_NON_CONFIRMABLE) &&
      (otCoapMessageGetCode(message) == OT_COAP_CODE_GET)) {
    msg_info = *message_info;
    memset(&msg_info.mSockAddr, 0, sizeof(msg_info.mSockAddr));

    error = provisioning_response_send(message, &msg_info);
    if (error == OT_ERROR_NONE) {
      srv_context.on_provisioning_request();
      srv_context.provisioning_enabled = false;
    }
  }
}

static void light_request_handler(void *context, otMessage *message,
                                  const otMessageInfo *message_info) {
  uint8_t command;

  ARG_UNUSED(context);

  if (otCoapMessageGetType(message) != OT_COAP_TYPE_NON_CONFIRMABLE) {
    LOG_ERR("Light handler - Unexpected type of message");
    goto end;
  }

  if (otCoapMessageGetCode(message) != OT_COAP_CODE_PUT) {
    LOG_ERR("Light handler - Unexpected CoAP code");
    goto end;
  }

  if (otMessageRead(message, otMessageGetOffset(message), &command, 1) != 1) {
    LOG_ERR("Light handler - Missing light command");
    goto end;
  }

  LOG_INF("Received light request: %c", command);

  srv_context.on_light_request(command);

end:
  return;
}
// Added
// New handler for sending text messages.
static void generic_request_handler(void *context, otMessage *message,
                                    const otMessageInfo *message_info) {
  char myBuffer[GENERIC_PAYLOAD_SIZE] = {};

  // otMessageLength could be used in place of generic payload size.

  otMessageRead(message, otMessageGetOffset(message), &myBuffer,
                GENERIC_PAYLOAD_SIZE);

  ARG_UNUSED(context);
  ARG_UNUSED(message_info);

  LOG_INF("Message received is:\n%s", myBuffer);

  srv_context.on_generic_request(myBuffer);
}
// Added/
static void float_request_handler(void *context, otMessage *message,
                                  const otMessageInfo *message_info) {
  double myBuffer = 0.0;

  // otMessageLength could be used in place of generic payload size.

  otMessageRead(message, otMessageGetOffset(message), &myBuffer,
                sizeof(double));
  if(val){
    dk_set_led_on(3);
  }
  else{
    dk_set_led_off(3);
  }
  val= !val;
  
  ARG_UNUSED(context);
  ARG_UNUSED(message_info);

  message_double = myBuffer;
  LOG_INF("Message received is:\n%f", myBuffer);
  
  srv_context.on_float_request(myBuffer);
}
static void percentage_request_handler(void *context, otMessage *message, const otMessageInfo *message_info) {
  struct percentageStructHidden myBuffer = {};
  otMessageRead(message, otMessageGetOffset(message), &myBuffer, PERCENTAGE_PAYLOAD_SIZE);
  struct percentageStruct out = {};

  ARG_UNUSED(context);
  ARG_UNUSED(message_info);

  LOG_INF("Label for percentage received: %s",myBuffer.identifier);
  for (int i = 0; i<3; i++) {
    out.percentages[i] = (double)myBuffer.percentages[i] / (double)4294967295;
  }
  LOG_INF("Percentages are: %f %f %f",out.percentages[0],out.percentages[1],out.percentages[2]);
  memcpy(&out.identifier,&myBuffer.identifier,8);
  out.messsageNum = myBuffer.messageNum;
  srv_context.on_percentage_request(out);
}
static void encoder_request_handler(void *context, otMessage *message,
                                  const otMessageInfo *message_info) {
  struct encoderMessage myBuffer = {};

  // otMessageLength could be used in place of generic payload size.

  otMessageRead(message, otMessageGetOffset(message), &myBuffer,
                ENCODER_PAYLOAD_SIZE);

  ARG_UNUSED(context);
  ARG_UNUSED(message_info);
  srv_context.on_encoder_request(myBuffer);
}
static void cmd_request_handler(void *context, otMessage *message,
                                  const otMessageInfo *message_info) {
  struct commandMsg myBuffer = {};

  // otMessageLength could be used in place of generic payload size.

  otMessageRead(message, otMessageGetOffset(message), &myBuffer,
                CMD_PAYLOAD_SIZE);

  ARG_UNUSED(context);
  ARG_UNUSED(message_info);
  srv_context.on_cmd_request(myBuffer);
}

double get_double(void){
  return message_double;
}

static void coap_default_handler(void *context, otMessage *message,
                                 const otMessageInfo *message_info) {
  ARG_UNUSED(context);
  ARG_UNUSED(message);
  ARG_UNUSED(message_info);

  LOG_INF("Received CoAP message that does not match any request "
          "or resource");
}

void ot_coap_activate_provisioning(void) {
  srv_context.provisioning_enabled = true;
}

void ot_coap_deactivate_provisioning(void) {
  srv_context.provisioning_enabled = false;
}

bool ot_coap_is_provisioning_active(void) {
  return srv_context.provisioning_enabled;
}

int ot_coap_init(provisioning_request_callback_t on_provisioning_request,
                 light_request_callback_t on_light_request,
                 generic_request_callback_t on_generic_request,
                 float_request_callback_t on_float_request,
                 percentage_request_callback_t on_percentage_request,
                 encoder_request_callback_t on_encoder_request,
                 cmd_request_callback_t on_cmd_request) {
  otError error;

  srv_context.provisioning_enabled = false;
  srv_context.on_provisioning_request = on_provisioning_request;
  srv_context.on_light_request = on_light_request;
  // Added
  srv_context.on_generic_request = on_generic_request;
  srv_context.on_float_request = on_float_request;
  srv_context.on_percentage_request = on_percentage_request;
  srv_context.on_encoder_request = on_encoder_request;
  srv_context.on_cmd_request = on_cmd_request;
  // Added/

  srv_context.ot = openthread_get_default_instance();
  if (!srv_context.ot) {
    LOG_ERR("There is no valid OpenThread instance");
    error = OT_ERROR_FAILED;
    goto end;
  }

  provisioning_resource.mContext = srv_context.ot;
  provisioning_resource.mHandler = provisioning_request_handler;

  light_resource.mContext = srv_context.ot;
  light_resource.mHandler = light_request_handler;

  // Added
  generic_resource.mContext = srv_context.ot;
  generic_resource.mHandler = generic_request_handler;

  float_resource.mContext = srv_context.ot;
  float_resource.mHandler = float_request_handler;

  percentage_resource.mContext=srv_context.ot;
  percentage_resource.mHandler=percentage_request_handler;

  encoder_resource.mContext=srv_context.ot;
  encoder_resource.mHandler=encoder_request_handler;

  cmd_resource.mContext=srv_context.ot;
  cmd_resource.mHandler=cmd_request_handler;
  // Added/

  otCoapSetDefaultHandler(srv_context.ot, coap_default_handler, NULL);
  otCoapAddResource(srv_context.ot, &light_resource);
  otCoapAddResource(srv_context.ot, &provisioning_resource);
  // Added
  otCoapAddResource(srv_context.ot, &generic_resource);
  otCoapAddResource(srv_context.ot, &float_resource);
  otCoapAddResource(srv_context.ot, &percentage_resource);
  otCoapAddResource(srv_context.ot, &encoder_resource);
  otCoapAddResource(srv_context.ot, &cmd_resource);
  // Added/

  error = otCoapStart(srv_context.ot, COAP_PORT);
  if (error != OT_ERROR_NONE) {
    LOG_ERR("Failed to start OT CoAP. Error: %d", error);
    goto end;
  }
end:
  return error == OT_ERROR_NONE ? 0 : 1;
}
```

## src/ot_coap_utils.h
```c
/*
 * Copyright (c) 2020 Nordic Semiconductor ASA
 *
 * SPDX-License-Identifier: LicenseRef-Nordic-5-Clause
 */

#ifndef __OT_COAP_UTILS_H__
#define __OT_COAP_UTILS_H__
#include <coap_server_client_interface.h>
#include <zephyr/kernel.h>

/**@brief Type definition of the function used to handle light resource change.
 */
typedef void (*light_request_callback_t)(uint8_t cmd);
typedef void (*provisioning_request_callback_t)();
// Added
typedef void (*generic_request_callback_t)(char *stringStart);
typedef void (*float_request_callback_t)(double floatNum);
typedef void (*percentage_request_callback_t)(struct percentageStruct percent);
typedef void (*encoder_request_callback_t)(struct encoderMessage encode);
typedef void (*cmd_request_callback_t)(struct commandMsg cmd);
// Added/

int ot_coap_init(provisioning_request_callback_t on_provisioning_request,
                 light_request_callback_t on_light_request,
                 generic_request_callback_t on_generic_request,
                 float_request_callback_t on_float_request,
                 percentage_request_callback_t on_percentage_request,
                 encoder_request_callback_t on_encoder_request,
                 cmd_request_callback_t on_cmd_request
                 );

void ot_coap_activate_provisioning(void);

void ot_coap_deactivate_provisioning(void);

bool ot_coap_is_provisioning_active(void);

double get_double(void);
#endif
```
